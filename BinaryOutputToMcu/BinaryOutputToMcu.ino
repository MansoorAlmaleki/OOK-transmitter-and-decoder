//(for square images only) the allocated size must be the image dimension squared (32 -> 32x32 = 1024 bits)
int ByteArray[1024] = {0,0,0,1,1,1,1,0,0,0,0,0,0,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0,0};
int BytePreambleArray[8] = {1,1,1,1,1,1,1,1};
int BytePostambleArray[8] = {1,1,1,1,1,1,1,1};

unsigned long CurrentMicros = 0;
unsigned long Index = 0;
bool RunPreAmble = true;
bool RunPostAmble = false;
bool RunByteData = false;
bool EndTransmission = false;

void setup() {
  // put your setup code here, to run once:
  pinMode(53, OUTPUT);

}

void loop() {

  if(micros() - CurrentMicros >= 25000 && EndTransmission == false){
    CurrentMicros = micros();

    if(RunPreAmble){
       if(Index > 7){
        RunPreAmble = false;
        RunByteData = true;
        Index = 0;
        digitalWrite(53, 0);

      }else{
        digitalWrite(53, BytePreambleArray[Index]);
      }
    }

    if(RunByteData){
      if(Index > 1023){
        RunByteData = false;
        RunPostAmble = true;
        Index = 0;
        digitalWrite(53, 0);
      }else{
        digitalWrite(53, ByteArray[Index]);
      }

    }

    if(RunPostAmble){
      if(Index > 7){
        EndTransmission = true;
        digitalWrite(53, 0);
      }else{
        digitalWrite(53, BytePostambleArray[Index]);
      }

    }
    Index++;
  }


}
